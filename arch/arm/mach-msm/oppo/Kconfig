## arch/arm/mach-msm/oppo/Kconfig
```kconfig
config MACH_OPPO
	bool
	depends on ARCH_APQ8064
	select FB_MSM_MIPI_DSI

menu "Oppo board selection"
source "arch/arm/mach-msm/oppo/Kconfig.board"
endmenu

menu "Oppo specific options"

config OPPO_TRACE
	tristate "Oppo trace driver"
	default n
	help
	  Oppo trace driver.

config OPPO_DEVICE_INFO
	bool "Oppo device info driver"
	default y if MACH_OPPO
	help
	  Oppo device info driver.

endmenu
```

## arch/arm/mach-msm/oppo/Kconfig.board
```kconfig
#
# Include the specific Kconfig file for Oppo boards
#

# N1
source "arch/arm/mach-msm/oppo/n1/Kconfig"

# X909
source "arch/arm/mach-msm/oppo/x909/Kconfig"
```

## arch/arm/mach-msm/oppo/n1/Kconfig
```kconfig
config MACH_N1
	depends on ARCH_MSM8960
	select MACH_OPPO
	bool "Oppo N1"
	help
	  Support for Oppo N1 device
```

## arch/arm/mach-msm/oppo/x909/Kconfig
```kconfig
config MACH_X909
	depends on ARCH_MSM8960
	select MACH_OPPO
	bool "Oppo X909"
	help
	  Support for Oppo X909 device
```
